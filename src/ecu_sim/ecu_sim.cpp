// ECU simulator firmware for a second ESP32 + MCP2515.
//
// Wire this board's MCP2515 to the main (device-under-test) board's MCP2515:
//   CANH <-> CANH, CANL <-> CANL. Both modules' onboard 120 ohm resistors form
//   a correctly terminated 2-node bench bus - no car or OBD port needed.
//
// It listens for the DUT's OBD requests and replays the real recorded ECU
// responses from recorded_responses.h (generated by scripts/log_to_header.py),
// stepping through the captured drive one sample per request so the dashboard
// animates just like the car. Multi-frame (ISO-TP) replies honour the DUT's
// flow-control frame.

#include <Arduino.h>
#include <SPI.h>
#include <mcp_can.h>

#include "config.h"
#include "recorded_responses.h"

namespace {

MCP_CAN canBus(CAN_CS_PIN);

// Per-key playback cursor: advances (and wraps) each time that PID is requested.
uint16_t gCursor[kSimKeyCount] = {};

uint32_t gRequestCount = 0;

constexpr unsigned long kFunctionalRequestId = 0x7DF;
constexpr unsigned long kPhysicalRequestLow = 0x7E0;
constexpr unsigned long kPhysicalRequestHigh = 0x7E7;
constexpr unsigned long kExtendedRequestId = 0x18DB33F1UL;

bool isRequestId(unsigned long id) {
  return id == kFunctionalRequestId || id == kExtendedRequestId ||
         (id >= kPhysicalRequestLow && id <= kPhysicalRequestHigh);
}

bool isFlowControl(unsigned long id, const uint8_t *data) {
  return id >= kPhysicalRequestLow && id <= kPhysicalRequestHigh &&
         (data[0] & 0xF0) == 0x30;
}

int findKey(uint8_t mode, uint8_t pid, bool hasPid) {
  for (uint16_t i = 0; i < kSimKeyCount; i++) {
    const SimKey &k = kSimKeys[i];
    if (k.mode == mode && (k.hasPid != 0) == hasPid && (!hasPid || k.pid == pid)) {
      return i;
    }
  }
  return -1;
}

void sendFrame(const SimFrame &f) {
  uint8_t buf[8];
  memcpy(buf, f.data, sizeof(buf));
  canBus.sendMsgBuf(f.id, 0, f.len, buf);
}

// Waits for the DUT's flow-control frame before streaming consecutive frames.
bool waitForFlowControl(uint32_t timeoutMs) {
  const uint32_t deadline = millis() + timeoutMs;
  while ((int32_t)(deadline - millis()) > 0) {
    if (canBus.checkReceive() != CAN_MSGAVAIL) {
      continue;
    }
    unsigned long id = 0;
    uint8_t len = 0;
    uint8_t data[8] = {};
    if (canBus.readMsgBuf(&id, &len, data) == CAN_OK && isFlowControl(id, data)) {
      return true;
    }
  }
  return false;
}

void playResponse(const SimResponse &r) {
  sendFrame(kSimFrames[r.frameStart]);
  if (r.frameCount <= 1) {
    return;  // single frame
  }

  // Multi-frame ISO-TP: first frame sent, wait for flow control, then the rest.
  waitForFlowControl(150);
  for (uint8_t i = 1; i < r.frameCount; i++) {
    sendFrame(kSimFrames[r.frameStart + i]);
    delayMicroseconds(500);
  }
}

void handleRequest(uint8_t mode, uint8_t pid, bool hasPid) {
  const int ki = findKey(mode, pid, hasPid);
  if (ki < 0) {
    return;  // not in the recording - DUT will mark it unsupported, like the car
  }

  const SimKey &k = kSimKeys[ki];
  if (k.respCount == 0) {
    return;
  }

  const uint16_t idx = k.respStart + (gCursor[ki] % k.respCount);
  gCursor[ki]++;
  playResponse(kSimResponses[idx]);

  if ((gRequestCount++ % 50) == 0) {
    Serial.printf("Served %lu requests (last: mode 0x%02X pid 0x%02X)\n",
                  (unsigned long)gRequestCount, mode, hasPid ? pid : 0);
  }
}

}  // namespace

void setup() {
  Serial.begin(115200);
  delay(500);

  Serial.println("ECU simulator (bench replay)");
  Serial.printf("Loaded %u PID keys from recorded_responses.h\n", kSimKeyCount);

  SPI.begin(CAN_SPI_SCK, CAN_SPI_MISO, CAN_SPI_MOSI, CAN_CS_PIN);
  pinMode(CAN_CS_PIN, OUTPUT);
  digitalWrite(CAN_CS_PIN, HIGH);

  if (canBus.begin(MCP_ANY, CAN_500KBPS, CAN_CLOCK) != CAN_OK) {
    Serial.println("MCP2515 init failed - check wiring and CAN_CLOCK (8 vs 16 MHz)");
    while (true) {
      delay(1000);
    }
  }

  canBus.setMode(MCP_NORMAL);
  Serial.println("Simulator ready at 500 kbps - waiting for OBD requests");
}

void loop() {
  if (canBus.checkReceive() != CAN_MSGAVAIL) {
    return;
  }

  unsigned long id = 0;
  uint8_t len = 0;
  uint8_t data[8] = {};
  if (canBus.readMsgBuf(&id, &len, data) != CAN_OK) {
    return;
  }

  if (!isRequestId(id) || len < 2) {
    return;
  }

  // Only single-frame requests (PCI 0x0) initiate a response; flow-control and
  // other frames are consumed inline while streaming a multi-frame reply.
  if ((data[0] & 0xF0) != 0x00) {
    return;
  }

  const uint8_t numBytes = data[0] & 0x0F;
  const uint8_t mode = data[1];
  const bool hasPid = numBytes >= 2 && len >= 3;
  const uint8_t pid = hasPid ? data[2] : 0;

  handleRequest(mode, pid, hasPid);
}
